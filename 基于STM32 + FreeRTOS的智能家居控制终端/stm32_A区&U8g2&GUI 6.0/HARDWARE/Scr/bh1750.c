/*-------------------------------------------------*/
/*                                                 */
/*             实现BH1750功能的源文件              */
/*                                                 */
/*-------------------------------------------------*/

#include "stm32f1xx_hal.h"  //包含需要的头文件
#include "bh1750.h"         //包含需要的头文件
#include "delay.h" 	        //包含需要的头文件			 
#include "iic.h"            //包含需要的头文件
#include "usart.h"          //包含需要的头文件

/*-------------------------------------------------*/
/*函数名：写BH1750                                 */
/*参  数：REG_Address：地址                        */
/*返回值：无                                       */
/*-------------------------------------------------*/
void Write_BH1750(unsigned char REG_Address)
{
    IIC_Start();                                   //起始信号
    IIC_Send_Byte(0x46);                           //发送设备地址+写信号
	if(IIC_Wait_Ack())u1_printf("等待应答超时1\r\n"); //串口输出信息
    IIC_Send_Byte(REG_Address);                    //内部寄存器地址，
    if(IIC_Wait_Ack())u1_printf("等待应答超时2\r\n"); //串口输出信息
    IIC_Stop();                                    //发送停止信号
}

/*-------------------------------------------------*/
/*函数名：读BH1750                                 */
/*参  数：无                                       */
/*返回值：无                                       */
/*-------------------------------------------------*/
uint16_t Read_BH1750(void)
{   	
    uint8_t dataH,dataL;
	
	IIC_Start();                                   //起始信号
    IIC_Send_Byte(0x47);                           //发送设备地址+读信号
	if(IIC_Wait_Ack())u1_printf("等待应答超时3\r\n"); //串口输出信息
	dataH=IIC_Read_Byte(1);                        //接收1字节数据，发送ACK
	dataL=IIC_Read_Byte(0);                        //再接收1字节数据，发送NACK
    IIC_Stop();                                    //停止信号
    Delay_Ms(5);                                   //延时
	return (dataH*256+dataL);                      //返回读取的值
}

/*-------------------------------------------------*/
/*函数名：数据采集                                 */
/*参  数：无                                       */
/*返回值：无                                       */
/*-------------------------------------------------*/
void Start_BH1750(void)
{
	Write_BH1750(0x01);	     //上电
	Write_BH1750(0x10);      //一次H分辨率模式，至少120ms，之后自动断电模式  
}
